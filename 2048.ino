

#include <Arduboy2.h>
Arduboy2 arduboy;

//pictures of 2,4,8,16...2048
const unsigned char p0[] PROGMEM  = {
     0xff, 0x1, 0x1, 0x1, 0x1, 0x1, 0x1, 0x1, 0x1, 0x1, 0x1, 0x1, 0x1, 0x1, 0x1, 0xff, 0xff, 0x80, 0x80, 0x80, 0x80, 0x80, 0x80, 0x80, 0x80, 0x80, 0x80, 0x80, 0x80, 0x80, 0x80, 0xff, 
};
const unsigned char p2[] PROGMEM  = {0xff, 0x01, 0x0d, 0x19, 0xf1, 0x19, 0x0d, 0x01, 0x01, 0xfd, 0x05, 0x05, 0x05, 0xfd, 0x01, 0xff, 0xff, 0x80, 0xbe, 0xa0, 0xa1, 0xa0, 0x80, 0x80, 0xbc, 0xa5, 0xa5, 0xa5, 0xa5, 0xbd, 0x80, 0xff, };
const unsigned char p4[] PROGMEM  = {0xff, 0x7d, 0x85, 0x85, 0xfd, 0xff, 0xff, 0xcf, 0xc7, 0xc7, 0xc7, 0xd7, 0xc5, 0xcd, 0x39, 0xff, 0xff, 0x80, 0x80, 0xbf, 0xbf, 0xbf, 0xbf, 0x9f, 0x87, 0x8f, 0xbf, 0xbf, 0xbf, 0xbf, 0x80, 0xff, };
const unsigned char p8[] PROGMEM  = {0xff, 0x39, 0x1d, 0x9f, 0xaf, 0xaf, 0x0f, 0x1f, 0x1f, 0xaf, 0xaf, 0x8f, 0x1f, 0x3d, 0x39, 0xff, 0xff, 0x98, 0xa0, 0xc3, 0xf3, 0x93, 0xd0, 0xd0, 0xd0, 0x93, 0xf3, 0xc3, 0xa0, 0xb0, 0x8c, 0xff, };
const unsigned char p16[] PROGMEM  = {0xff, 0x05, 0x03, 0x79, 0x85, 0xa5, 0xc9, 0x21, 0x21, 0xc9, 0xa5, 0x85, 0x79, 0x03, 0x05, 0xff, 0xff, 0x81, 0xe2, 0x92, 0x8a, 0xa6, 0xa9, 0xa0, 0xa0, 0xa9, 0xa6, 0x8a, 0x92, 0xe2, 0x81, 0xff, };
const unsigned char p32[] PROGMEM  = {0xff, 0x01, 0x21, 0x31, 0x71, 0x79, 0x4d, 0xd5, 0x85, 0x7d, 0x01, 0x01, 0x01, 0x01, 0x01, 0xff, 0xff, 0x80, 0x80, 0x80, 0x80, 0xde, 0xf1, 0x90, 0xa1, 0xa3, 0xa2, 0xa2, 0xe2, 0xec, 0xb0, 0xff, };
const unsigned char p64[] PROGMEM  = {0xff, 0x41, 0x71, 0x9d, 0x87, 0x2d, 0x09, 0x09, 0x49, 0x0d, 0x27, 0x05, 0x89, 0x51, 0x21, 0xff, 0xff, 0xf2, 0xe3, 0xb9, 0x8c, 0x82, 0x92, 0x9b, 0x91, 0x91, 0x87, 0x8c, 0xb8, 0xe1, 0xf9, 0xff, };
const unsigned char p128[] PROGMEM  = {0xff, 0x15, 0x1b, 0x81, 0x9f, 0x93, 0x9f, 0x81, 0x0f, 0x91, 0x4f, 0x21, 0x5f, 0xc5, 0x07, 0xff, 0xff, 0x80, 0x87, 0x9b, 0xa2, 0xa2, 0xa2, 0xa2, 0xa2, 0x93, 0x92, 0x89, 0x8d, 0x87, 0x80, 0xff, };
const unsigned char p256[] PROGMEM  = {0xff, 0x01, 0x99, 0x5d, 0x3d, 0xd1, 0xb1, 0x51, 0x51, 0xb1, 0xd1, 0x3d, 0xdd, 0x99, 0x01, 0xff, 0xff, 0xa0, 0x9f, 0x98, 0xf0, 0xc0, 0x86, 0xa8, 0xa8, 0xa6, 0x80, 0xc0, 0xf0, 0x9d, 0x97, 0xff, };
const unsigned char p512[] PROGMEM  = {0xff, 0x11, 0x11, 0x1b, 0x0f, 0x81, 0xc1, 0x41, 0x61, 0x21, 0x31, 0x91, 0x99, 0xad, 0x07, 0xff, 0xff, 0xc6, 0x92, 0xa9, 0x85, 0xbd, 0xbe, 0xa6, 0xa3, 0xbb, 0xa1, 0xbd, 0x87, 0xac, 0x84, 0xff, };
const unsigned char p1024[] PROGMEM  = {0xff, 0x25, 0xc9, 0x59, 0x11, 0xc9, 0x45, 0x85, 0x85, 0x45, 0xcd, 0x09, 0xd1, 0x49, 0x25, 0xff, 0xff, 0x80, 0xff, 0xc3, 0x84, 0x84, 0x84, 0x9c, 0xbc, 0xcc, 0xc4, 0x86, 0x83, 0xff, 0x80, 0xff, };
const unsigned char p2048[] PROGMEM  = {0xff, 0x01, 0xfd, 0xfd, 0x01, 0x01, 0x31, 0xf9, 0xf9, 0xf1, 0xf1, 0xf9, 0xf9, 0x31, 0x01, 0xff, 0xff, 0x80, 0xbe, 0xbe, 0xb0, 0xb0, 0xbe, 0xbe, 0x81, 0x83, 0x83, 0x81, 0x80, 0x80, 0x80, 0xff, };
int v[4][4];//map 4*4
int vtmp[4][4];//
int p[12];//remember picture's home


//input the value return the index of p[]
int v2p(int x){
  switch(x){
    case 0:return 0;
    case 2:return 1;
    case 4:return 2;
    case 8:return 3;
    case 16:return 4;
    case 32:return 5;
    case 64:return 6;
    case 128:return 7;
    case 256:return 8;
    case 512:return 9;
    case 1024:return 10;
    case 2048:return 11;
  }
}

//set one number(2 or 4) in the map
void set2or4(){
  int f1=0;
  for(int i=0;i<4;i++){
    for(int j=0;j<4;j++){
      if(v[i][j]==0){
        f1++;
      }
    }
  }

  int f2=0;
  
  
  int r = 1 + rand() % f1;
  int w = 1 + rand() % 10;
  for(int i=0;i<4;i++){
    for(int j=0;j<4;j++){
      if(v[i][j]==0){
        f2++;
        if(f2==r){
          if(w==6){
            v[i][j]=4;
          }
          else{
            v[i][j]=2;
          }
          
          return;
        }
      }
    }
  }
  
}

//draw the map
void draw(){
  for(int i=0;i<4;i++){
      for(int j=0;j<4;j++){
        arduboy.drawBitmap(i*16, j*16, p[v2p(v[i][j])], 16, 16, WHITE);
      }
    }
}

//back 0 to the end
bool back0(){
  bool f=0;
  for(int i=0;i<4;i++){
      for(int j=0;j<3;j++){
        if(v[i][j]==0&&v[i][j+1]!=0){
          f=1;
          v[i][j]=v[i][j+1];
          v[i][j+1]=0;
        }
      }
    }
    return f;
    
}

//Up
bool DoUp(){
  delay(400);
    bool f=back0();
    back0();
    back0();
    
    for(int i=0;i<4;i++){
      for(int j=0;j<3;j++){
        if(v[i][j]==v[i][j+1]&&v[i][j]!=0){
          f=true;
          v[i][j]*=2;
          v[i][j+1]=0;
        }
      }
    }
    back0();
    back0();
    back0();
    return f;
    
}

void Down(){
  for(int i=0;i<4;i++){
      for(int j=0;j<4;j++){
        vtmp[3-i][3-j]=v[i][j];
      }
    }
    for(int i=0;i<4;i++){
      for(int j=0;j<4;j++){
        v[i][j]=vtmp[i][j];
      }
    }
}

void Left(){
  for(int i=0;i<4;i++){
      for(int j=0;j<4;j++){
        vtmp[3-j][i]=v[i][j];
      }
    }
    for(int i=0;i<4;i++){
      for(int j=0;j<4;j++){
        v[i][j]=vtmp[i][j];
      }
    }
}

void Right(){
  for(int i=0;i<4;i++){
      for(int j=0;j<4;j++){
        vtmp[i][j]=v[3-j][i];
      }
    }
    for(int i=0;i<4;i++){
      for(int j=0;j<4;j++){
        v[i][j]=vtmp[i][j];
      }
    }
}

void setup() {
    arduboy.begin();
    arduboy.clear();

    //initialization
    for(int i=0;i<4;i++){
      for(int j=0;j<4;j++){
        v[i][j]=0;
      }
    }

    //remember picture's home
    p[0]=p0;p[1]=p2;p[2]=p4;p[3]=p8;p[4]=p16;p[5]=p32;p[6]=p64;p[7]=p128;p[8]=p256;p[9]=p512;p[10]=p1024;p[11]=p2048;

    //First set two numubers
    set2or4();
    set2or4();
    draw();
    arduboy.display();
    
    
    
}
void loop() {
  arduboy.clear();
  
  if( arduboy.pressed(UP_BUTTON) == true ){
    bool f=DoUp();
     
    if(f)set2or4(); 
  }
  else if( arduboy.pressed(DOWN_BUTTON) == true ){
    
    Down();
    bool f=DoUp();
    Down();

    if(f)set2or4();
    
  }
  else if( arduboy.pressed(RIGHT_BUTTON) == true ){
    Right(); 
    bool f=DoUp();
    Left();
    if(f)set2or4();
  }
  else if( arduboy.pressed(LEFT_BUTTON) == true ){
    Left(); 
    bool f=DoUp();
    Right();
    if(f)set2or4();
  }
   
    draw();
    arduboy.display();
}
